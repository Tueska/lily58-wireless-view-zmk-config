## config/west.yml
```yaml
manifest:
  remotes:
    - name: zmkfirmware
      url-base: https://github.com/zmkfirmware
    - name: infely
      url-base: https://github.com/infely
    - name: bwshockley
      url-base: https://github.com/bwshockley
    - name: gpeye
      url-base: https://github.com/GPeye
  projects:
    - name: zmk
      remote: zmkfirmware
      revision: v0.3
      import: app/west.yml
    - name: nice-view-battery
      remote: infely
      revision: main
    - name: zmk-dongle-screen
      remote: bwshockley
      revision: main
    - name: hammerbeam-slideshow
      remote: gpeye
      revision: main
  self:
    path: config
```
